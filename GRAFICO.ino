void GRAFICO_linha(char x1, char y1, char z1, char x2, char y2, char z2, bool aceso){
    
    char i, dx, dy, dz, l, m, n, x_inc, y_inc, z_inc, err_1, err_2, dx2, dy2, dz2;
    char point[3];
    
    point[0] = x1;
    point[1] = y1;
    point[2] = z1;
    dx = x2 - x1;
    dy = y2 - y1;
    dz = z2 - z1;
    x_inc = (dx < 0) ? -1 : 1;
    l = abs(dx);
    y_inc = (dy < 0) ? -1 : 1;
    m = abs(dy);
    z_inc = (dz < 0) ? -1 : 1;
    n = abs(dz);
    dx2 = l << 1;
    dy2 = m << 1;
    dz2 = n << 1;
    
    if ((l >= m) && (l >= n)) {
        err_1 = dy2 - l;
        err_2 = dz2 - l;
        for (i = 0; i < l; i++) {
            CUBO_point(point[0],point[1],point[2],aceso);
            if (err_1 > 0) {
                point[1] += y_inc;
                err_1 -= dx2;
            }
            if (err_2 > 0) {
                point[2] += z_inc;
                err_2 -= dx2;
            }
            err_1 += dy2;
            err_2 += dz2;
            point[0] += x_inc;
        }
    } else if ((m >= l) && (m >= n)) {
        err_1 = dx2 - m;
        err_2 = dz2 - m;
        for (i = 0; i < m; i++) {
            CUBO_point(point[0],point[1],point[2],aceso);
            if (err_1 > 0) {
                point[0] += x_inc;
                err_1 -= dy2;
            }
            if (err_2 > 0) {
                point[2] += z_inc;
                err_2 -= dy2;
            }
            err_1 += dx2;
            err_2 += dz2;
            point[1] += y_inc;
        }
    } else {
        err_1 = dy2 - n;
        err_2 = dx2 - n;
        for (i = 0; i < n; i++) {
            CUBO_point(point[0],point[1],point[2],aceso);
            if (err_1 > 0) {
                point[1] += y_inc;
                err_1 -= dz2;
            }
            if (err_2 > 0) {
                point[0] += x_inc;
                err_2 -= dz2;
            }
            err_1 += dy2;
            err_2 += dx2;
            point[2] += z_inc;
        }
    }
    CUBO_point(point[0],point[1],point[2],aceso);
}


const unsigned char LETRAS_BITMAP[96][8] PROGMEM = {
{0b00000000, 0b00000000, 0b00000000, 0b00000000, 0b00000000, 0b00000000, 0b00000000, 0b00000000},
{0b00011000, 0b00011000, 0b00011000, 0b00011000, 0b00011000, 0b00000000, 0b00011000, 0b00000000},
{0b01101100, 0b01101100, 0b00000000, 0b00000000, 0b00000000, 0b00000000, 0b00000000, 0b00000000},
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{0b00000000, 0b00000000, 0b00000000, 0b00000000, 0b00000000, 0b00000000, 0b00000000, 0b00000000} };
void GRAFICO_letra(char ch, char x, char y, char z, bool aceso, char dxx, char dxy, char dxz, char dyx, char dyy, char dyz){
  char letra[8], i, j, k;
  if(ch<32||ch>=128)return;
  if(x<-8||x>16||y<-8||y>16||y<-8||y>16)return;
  for(i=0;i<8;i++){
    letra[i] = pgm_read_byte_near(LETRAS_BITMAP[ch-32]+i);
    //Serial.println(letra[i],BIN);
  }
  if(aceso){      
    for(i=0;i<8;i++){
      for(j=0;j<8;j++){
          if(letra[7-j]&(1<<(7-i)))CUBO_setPoint(x+dxx*i+dyx*j,y+dxy*i+dyy*j,z+dxz*i+dyz*j);
      }
    }
  }else{
    for(i=0;i<8;i++){
      for(j=0;j<8;j++){
          if(letra[7-j]&(1<<(7-i)))CUBO_clearPoint(x+dxx*i+dyx*j,y+dxy*i+dyy*j,z+dxz*i+dyz*j);
      }
    }
  }
}
void GRAFICO_printStr(char *str, char x, char y, char z, bool aceso, char dxx, char dxy, char dxz, char dyx, char dyy, char dyz){
  char pos = 0;
  while(str[pos]){
    GRAFICO_letra(str[pos],x+pos*dxx*8,y+pos*dxy*8,z+pos*dxz*8,aceso,dxx,dxy,dxz,dyx,dyy,dyz);
    pos++;
  }
}


